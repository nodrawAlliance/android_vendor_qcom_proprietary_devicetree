/dts-v1/;
/plugin/;

#include <dt-bindings/interrupt-controller/arm-gic.h>
#include "khajep-idp.dtsi"
#include "sapphiren-sm6225.dtsi"

/ {
	model = "Qualcomm Technologies, Inc. Khaje IDP sapphiren";
	compatible = "qcom,khaje-idp", "qcom,khaje", "qcom,idp";
	qcom,msm-id = <0x24A 0x10000 0x206 0x10000>;
	qcom,board-id = <0x30022 0x00>;
	qcom,pmic-id = <0x2D 0x2E 0x00 0x00>;
};
